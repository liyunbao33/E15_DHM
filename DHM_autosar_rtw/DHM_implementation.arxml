AUTOSAR XML (schema 4-3-1)
package /Components/SwcImplementations
  swc implementation DHM_Impl: programming-language=C, sw-version=1.12.1, used-code-generator=Embedded Coder 7.8 (R2022a) 23-Nov-2021, vendor-id=0, behavior=DHM
    code-descriptors:
      code Code
        artifact-descriptors:
          short-label=DHM_c, category=SWSRC
          short-label=DHM_h, category=SWHDR
          short-label=DHM_private_h, category=SWHDR
          short-label=DHM_types_h, category=SWHDR
          short-label=rtwtypes_h, category=SWHDR
    resource consumption RsrcCons_DHM
